## drivers/spi/Kconfig.rpi_pico
```kconfig
# Copyright (c) 2023 Stephen Boylan <stephen.boylan@beechwoods.com>
# SPDX-License-Identifier: Apache-2.0

config SPI_RPI_PICO_PIO
	bool "Raspberry Pi PICO PIO SPI controller driver"
	default y
	depends on DT_HAS_RASPBERRYPI_PICO_SPI_PIO_ENABLED
	select PICOSDK_USE_PIO
	select PICOSDK_USE_CLAIM
	help
	  Enable driving SPI via PIO on the PICO

if SPI_RPI_PICO_PIO

config SPI_RPI_PICO_PIO_HALF_DUPLEX
	bool "PIO half-duplex support"
	help
	  Enable half-duplex (3-wire) operation.

config SPI_RPI_PICO_PIO_8_BIT
	bool "PIO 8-bit support"
	default y
	help
	  Enable any addtional code needed to
	  support 8-bit transfers.

config SPI_RPI_PICO_PIO_16_BIT
	bool "PIO 16-bit support"
	help
	  Enable any addtional code needed to
	  support 16-bit transfers.

config SPI_RPI_PICO_PIO_32_BIT
	bool "PIO 32-bit support"
	help
	  Enable any addtional code needed to
	  support 32-bit transfers.

endif
```

## dts/bindings/spi/raspberrypi,pico-spi-pio.yaml
```yaml
# Copyright (c) 2023 Stephen Boylan <stephen.boylan@beechwoods.com>
# SPDX-License-Identifier: Apache-2.0

description: Raspberry Pi Pico SPI via PIO

compatible: "raspberrypi,pico-spi-pio"

include: ["spi-controller.yaml", "raspberrypi,pico-pio-device.yaml", "reset-device.yaml"]

properties:
  clk-gpios:
    type: phandle-array
    required: true
    description: |
      Output pin for SPI clock

  mosi-gpios:
    type: phandle-array
    description: |
      MOSI gpio info. Output pin for Master Out Slave In.

  miso-gpios:
    type: phandle-array
    description: |
      MISO gpio info. Input pin for Master In Slave Out.

  clocks:
    required: true
```

## dts/bindings/wifi/infineon,airoc-wifi-common.yaml
```yaml
include: [base.yaml, pinctrl-device.yaml]

properties:
  wifi-reg-on-gpios:
    description: |
      Power-up/down gpio to control the internal regulators used
      by the WiFi section of AIROC Wi-Fi device.
    type: phandle-array

  wifi-host-wake-gpios:
    description: |
      Host wake-up gpio. Signal from the AIROC Wi-Fi device
      to the host indicating that the device requires attention.
    type: phandle-array

  wifi-dev-wake-gpios:
    description: |
      WiFi device wake-up gpio. Signal from the host to the
      AIROC Wi-Fi device indicating that the host requires attention.
    type: phandle-array
```

## dts/bindings/wifi/infineon,airoc-wifi-spi.yaml
```yaml
description: |
  AIROC Wi-Fi Connectivity over SPI.

compatible: "infineon,airoc-wifi"

include: [spi-device.yaml, "infineon,airoc-wifi-common.yaml"]

properties: 
  wifi-host-wake-gpios:
    required: true
    description: |
      Host wake-up gpio. Signal from the AIROC Wi-Fi device
      to the host indicating that the device requires attention.
    type: phandle-array

  spi-half-duplex:
    description:
      Use half-duplex communication;  if not present, full-
      duplex operation is assumed.
    type: boolean

  spi-word-size:
    description:
      SPI word size in bits.
    type: int
    enum:
      - 8
      - 16
      - 32
    default: 8
```

## dts/bindings/wifi/infineon,airoc-wifi.yaml
```yaml
# Copyright (c) 2023 Cypress Semiconductor Corporation (an Infineon company) or
# an affiliate of Cypress Semiconductor Corporation
#
# SPDX-License-Identifier: Apache-2.0

description: |
    AIROC Wi-Fi Connectivity.

    Example of enabling AIROC Wi-Fi device (for SDIO):
      &sdhc0 {
        status = "okay";

        /* SDIO pins */
        pinctrl-0 = <&p2_4_sdio_cmd &p2_5_sdio_clk &p2_0_sdio_data0
              &p2_1_sdio_data1 &p2_2_sdio_data2 &p2_3_sdio_data3>;
        pinctrl-names = "default";

        /* Wifi configuration */
        airoc-wifi {
          status = "okay";
          compatible = "infineon,airoc-wifi-sdio";

          /* Wi-Fi control gpios */
          wifi-reg-on-gpios    = <&gpio_prt2 6 GPIO_ACTIVE_HIGH>;
          wifi-host-wake-gpios = <&gpio_prt0 4 GPIO_ACTIVE_HIGH>;
        };
      };

compatible: "infineon,airoc-wifi"

include: [base.yaml, pinctrl-device.yaml, "infineon,airoc-wifi-common.yaml"]

properties: {}
```
